## Documentation/devicetree/bindings/misc/gpio-logic-analyzer.yaml
```yaml
# SPDX-License-Identifier: GPL-2.0
%YAML 1.2
---
$id: http://devicetree.org/schemas/misc/gpio-logic-analyzer.yaml#
$schema: http://devicetree.org/meta-schemas/core.yaml#

title: Bindings for a GPIO based logic analyzer

maintainers:
  - Wolfram Sang <wsa@sang-engineering.com>

properties:
  compatible:
    items:
      - const: gpio-logic-analyzer

  probe-gpios:
    description:
      gpios used as probes for the logic analyzer

  probe-names:
    description:
      names used to distinguish the probes

  required:
    - compatible
    - probe-gpios

additionalProperties: false

examples:
  - |
    i2c-analyzer {
            compatible = "gpio-logic-analyzer";

            probe-gpios = <&gpio6 21 GPIO_OPEN_DRAIN>, <&gpio6 4 GPIO_OPEN_DRAIN>;
            probe-names = "SCL", "SDA";
    };

...
```

## drivers/firmware/arm_ffa/Kconfig
```kconfig
# SPDX-License-Identifier: GPL-2.0-only
config ARM_FFA_TRANSPORT
	tristate "Arm Firmware Framework for Armv8-A"
	depends on OF
	depends on ARM64
	default n
	help
	  This Firmware Framework(FF) for Arm A-profile processors describes
	  interfaces that standardize communication between the various
	  software images which includes communication between images in
	  the Secure world and Normal world. It also leverages the
	  virtualization extension to isolate software images provided
	  by an ecosystem of vendors from each other.

	  This driver provides interface for all the client drivers making
	  use of the features offered by ARM FF-A.

config ARM_FFA_SMCCC
	bool
	default ARM_FFA_TRANSPORT
	depends on ARM64 && HAVE_ARM_SMCCC_DISCOVERY

config ARM_FFA_ACS_USER
    tristate "ACS User space FF-A interface"
    depends on ARM_FFA_TRANSPORT
    default n
    help
      Enable a character interface that can be used by the Architecture
      Compliant Suite user application to validate the compliance of the
      underlying system.
      When the interface is opened, all other FF-A clients interfaces
      inside the kernel are disabled (drivers get a BUSY error back) and
      all notification handling is delegated to the ACS user space application.
      Once the interface is closed, all behaviours goes back to normal.

      This option shall not be enabled in a production system but only during
      development.
```
